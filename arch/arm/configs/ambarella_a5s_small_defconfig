## arch/arm64/configs/ambarella_h2_cv1_defconfig
```kconfig
# CONFIG_LOCALVERSION_AUTO is not set
CONFIG_DEFAULT_HOSTNAME="Ambarella"
CONFIG_SYSVIPC=y
CONFIG_POSIX_MQUEUE=y
CONFIG_FHANDLE=y
CONFIG_IRQ_DOMAIN_DEBUG=y
CONFIG_NO_HZ_IDLE=y
CONFIG_HIGH_RES_TIMERS=y
CONFIG_BSD_PROCESS_ACCT=y
CONFIG_BSD_PROCESS_ACCT_V3=y
CONFIG_IKCONFIG=y
CONFIG_IKCONFIG_PROC=y
CONFIG_LOG_BUF_SHIFT=16
CONFIG_CGROUP_HUGETLB=y
# CONFIG_UTS_NS is not set
# CONFIG_IPC_NS is not set
CONFIG_SCHED_AUTOGROUP=y
CONFIG_BLK_DEV_INITRD=y
CONFIG_EXPERT=y
# CONFIG_COMPAT_BRK is not set
CONFIG_PROFILING=y
CONFIG_JUMP_LABEL=y
CONFIG_MODULES=y
CONFIG_MODULE_UNLOAD=y
CONFIG_BLK_DEV_BSGLIB=y
CONFIG_PARTITION_ADVANCED=y
# CONFIG_EFI_PARTITION is not set
CONFIG_ARCH_AMBARELLA=y
CONFIG_NR_CPUS=4
CONFIG_PREEMPT=y
# CONFIG_BOUNCE is not set
CONFIG_CMA=y
CONFIG_CMDLINE="console=ttyS0"
# CONFIG_EFI is not set
# CONFIG_CORE_DUMP_DEFAULT_ELF_HEADERS is not set
CONFIG_COMPAT=y
CONFIG_NET=y
CONFIG_PACKET=y
CONFIG_UNIX=y
CONFIG_UNIX_DIAG=y
CONFIG_XFRM_USER=y
CONFIG_INET=y
CONFIG_IP_MULTICAST=y
CONFIG_IP_ADVANCED_ROUTER=y
CONFIG_IP_PNP=y
CONFIG_IP_PNP_DHCP=y
CONFIG_IP_PNP_BOOTP=y
# CONFIG_INET_XFRM_MODE_TRANSPORT is not set
# CONFIG_INET_XFRM_MODE_TUNNEL is not set
# CONFIG_INET_XFRM_MODE_BEET is not set
# CONFIG_INET_LRO is not set
# CONFIG_INET_DIAG is not set
# CONFIG_IPV6 is not set
CONFIG_DNS_RESOLVER=y
CONFIG_BT=m
CONFIG_BT_RFCOMM=m
CONFIG_BT_RFCOMM_TTY=y
CONFIG_BT_BNEP=m
CONFIG_BT_BNEP_MC_FILTER=y
CONFIG_BT_BNEP_PROTO_FILTER=y
CONFIG_BT_HCIBTUSB=m
CONFIG_BT_HCIBTSDIO=m
CONFIG_BT_HCIUART=m
CONFIG_BT_HCIUART_H4=y
CONFIG_BT_HCIUART_BCSP=y
CONFIG_BT_HCIUART_LL=y
CONFIG_CFG80211=m
CONFIG_CFG80211_DEBUGFS=y
CONFIG_CFG80211_INTERNAL_REGDB=y
CONFIG_CFG80211_WEXT=y
CONFIG_MAC80211=m
CONFIG_RFKILL=m
CONFIG_ARCH_AMBARELLA_CV=m
CONFIG_DEVTMPFS=y
CONFIG_DEVTMPFS_MOUNT=y
# CONFIG_STANDALONE is not set
# CONFIG_PREVENT_FIRMWARE_BUILD is not set
# CONFIG_FIRMWARE_IN_KERNEL is not set
CONFIG_DMA_CMA=y
CONFIG_CONNECTOR=y
CONFIG_MTD=y
CONFIG_MTD_CMDLINE_PARTS=y
CONFIG_MTD_BLOCK=y
CONFIG_MTD_NAND=y
CONFIG_MTD_NAND_ECC_BCH=y
CONFIG_MTD_NAND_AMBARELLA=y
CONFIG_MTD_UBI=y
CONFIG_BLK_DEV_LOOP=y
CONFIG_BLK_DEV_RAM=y
CONFIG_BLK_DEV_RAM_COUNT=1
CONFIG_BLK_DEV_RAM_SIZE=65536
CONFIG_SCSI=m
CONFIG_BLK_DEV_SD=m
CONFIG_NETDEVICES=y
CONFIG_NETCONSOLE=y
CONFIG_NETCONSOLE_DYNAMIC=y
CONFIG_NET_VENDOR_AMBARELLA=m
CONFIG_NET_VENDOR_AMBARELLA_INTEN_TUE=y
# CONFIG_NET_VENDOR_AMD is not set
# CONFIG_NET_VENDOR_ARC is not set
# CONFIG_NET_CADENCE is not set
# CONFIG_NET_VENDOR_BROADCOM is not set
# CONFIG_NET_VENDOR_EZCHIP is not set
# CONFIG_NET_VENDOR_HISILICON is not set
# CONFIG_NET_VENDOR_INTEL is not set
# CONFIG_NET_VENDOR_MARVELL is not set
# CONFIG_NET_VENDOR_MICREL is not set
# CONFIG_NET_VENDOR_MICROCHIP is not set
# CONFIG_NET_VENDOR_NATSEMI is not set
# CONFIG_NET_VENDOR_QUALCOMM is not set
# CONFIG_NET_VENDOR_RENESAS is not set
# CONFIG_NET_VENDOR_ROCKER is not set
# CONFIG_NET_VENDOR_SAMSUNG is not set
# CONFIG_NET_VENDOR_SEEQ is not set
# CONFIG_NET_VENDOR_SMSC is not set
# CONFIG_NET_VENDOR_STMICRO is not set
# CONFIG_NET_VENDOR_SYNOPSYS is not set
# CONFIG_NET_VENDOR_VIA is not set
# CONFIG_NET_VENDOR_WIZNET is not set
CONFIG_REALTEK_PHY=m
CONFIG_MICREL_PHY=m
# CONFIG_INPUT_MOUSEDEV_PSAUX is not set
CONFIG_INPUT_EVDEV=m
# CONFIG_KEYBOARD_ATKBD is not set
CONFIG_KEYBOARD_GPIO=m
# CONFIG_INPUT_MOUSE is not set
CONFIG_INPUT_MISC=y
CONFIG_INPUT_UINPUT=m
# CONFIG_SERIO is not set
# CONFIG_LEGACY_PTYS is not set
# CONFIG_DEVKMEM is not set
CONFIG_SERIAL_AMBARELLA=y
CONFIG_SERIAL_AMBARELLA_CONSOLE=y
# CONFIG_HW_RANDOM is not set
CONFIG_I2C=y
# CONFIG_I2C_COMPAT is not set
CONFIG_I2C_CHARDEV=m
# CONFIG_I2C_HELPER_AUTO is not set
CONFIG_I2C_SMBUS=m
CONFIG_I2C_AMBARELLA=y
CONFIG_SPI=y
CONFIG_SPI_AMBARELLA=m
CONFIG_SPI_SPIDEV=m
CONFIG_GPIO_SYSFS=y
CONFIG_GPIO_PCA953X=y
CONFIG_GPIO_PCA953X_IRQ=y
CONFIG_GPIO_PCF857X=y
CONFIG_POWER_RESET_XGENE=y
CONFIG_POWER_RESET_SYSCON=y
# CONFIG_HWMON is not set
CONFIG_WATCHDOG=y
CONFIG_AMBARELLA_WATCHDOG=y
CONFIG_MEDIA_SUPPORT=m
CONFIG_MEDIA_RC_SUPPORT=y
CONFIG_RC_DEVICES=y
CONFIG_IR_AMBARELLA=m
CONFIG_FB=y
CONFIG_FB_AMBARELLA=m
CONFIG_BACKLIGHT_LCD_SUPPORT=y
# CONFIG_BACKLIGHT_GENERIC is not set
CONFIG_BACKLIGHT_PWM=m
CONFIG_FRAMEBUFFER_CONSOLE=m
CONFIG_SOUND=m
CONFIG_SND=m
# CONFIG_SND_SUPPORT_OLD_API is not set
# CONFIG_SND_DRIVERS is not set
# CONFIG_SND_SPI is not set
CONFIG_SND_SOC=m
CONFIG_SND_AMBARELLA_SOC=m
CONFIG_SND_AMBARELLA_BOARD=m
CONFIG_AMBA_BOARD=m
CONFIG_SND_AMBARELLA_CODEC=m
CONFIG_SND_SOC_AK4642_AMB=m
CONFIG_SND_SOC_AK4951_AMB=m
CONFIG_SND_SOC_AK4954_AMB=m
CONFIG_SND_AMBARELLA_SOC_DMIC=m
CONFIG_HID=m
CONFIG_USB=m
CONFIG_USB_ANNOUNCE_NEW_DEVICES=y
# CONFIG_USB_DEFAULT_PERSIST is not set
CONFIG_USB_EHCI_HCD=m
CONFIG_USB_EHCI_ROOT_HUB_TT=y
CONFIG_USB_EHCI_AMBARELLA=m
CONFIG_USB_OHCI_HCD=m
CONFIG_USB_OHCI_AMBARELLA=y
CONFIG_USB_STORAGE=m
CONFIG_USB_SERIAL=m
CONFIG_USB_SERIAL_GENERIC=y
CONFIG_USB_AMBARELLA_PHY=y
CONFIG_USB_GADGET=y
CONFIG_USB_GADGET_VBUS_DRAW=500
CONFIG_USB_AMBARELLA=m
CONFIG_USB_ETH=m
CONFIG_USB_MASS_STORAGE=m
CONFIG_USB_G_SERIAL=m
CONFIG_USB_G_MULTI=m
CONFIG_MMC=m
CONFIG_MMC_BLOCK_MINORS=32
# CONFIG_MMC_BLOCK_BOUNCE is not set
CONFIG_MMC_AMBARELLA=m
CONFIG_RTC_CLASS=y
CONFIG_RTC_INTF_DEV_UIE_EMUL=y
CONFIG_RTC_DRV_AMBARELLA=y
CONFIG_DMADEVICES=y
CONFIG_AMBARELLA_DMA=y
# CONFIG_COMMON_CLK_XGENE is not set
# CONFIG_IOMMU_SUPPORT is not set
CONFIG_IIO=m
CONFIG_IIO_BUFFER_CB=m
CONFIG_IIO_SW_TRIGGER=m
CONFIG_AMBARELLA_ADC=m
CONFIG_INV_MPU9250_SPI=m
CONFIG_AK8975=m
CONFIG_IIO_HRTIMER_TRIGGER=m
CONFIG_IIO_INTERRUPT_TRIGGER=m
CONFIG_IIO_SYSFS_TRIGGER=m
CONFIG_PWM=y
CONFIG_PWM_AMBARELLA=m
CONFIG_EXT4_FS=m
CONFIG_EXT4_FS_POSIX_ACL=y
CONFIG_EXT4_FS_SECURITY=y
# CONFIG_DNOTIFY is not set
CONFIG_FUSE_FS=m
CONFIG_CUSE=m
CONFIG_VFAT_FS=y
CONFIG_TMPFS=y
CONFIG_TMPFS_POSIX_ACL=y
CONFIG_HUGETLBFS=y
CONFIG_CONFIGFS_FS=y
CONFIG_UBIFS_FS=y
CONFIG_UBIFS_FS_ADVANCED_COMPR=y
CONFIG_SQUASHFS=y
CONFIG_SQUASHFS_LZ4=y
CONFIG_SQUASHFS_LZO=y
CONFIG_SQUASHFS_XZ=y
CONFIG_NFS_FS=y
CONFIG_ROOT_NFS=y
CONFIG_NFSD=m
CONFIG_NFSD_V3=y
CONFIG_CIFS=y
CONFIG_CIFS_STATS=y
CONFIG_NLS_DEFAULT="utf8"
CONFIG_NLS_CODEPAGE_437=y
CONFIG_NLS_ISO8859_1=y
CONFIG_NLS_UTF8=y
CONFIG_PRINTK_TIME=y
CONFIG_DYNAMIC_DEBUG=y
CONFIG_DEBUG_FS=y
CONFIG_DEBUG_SECTION_MISMATCH=y
CONFIG_KEYS=y
CONFIG_CRYPTO_CRC32C=y
CONFIG_CRYPTO_ANSI_CPRNG=y
CONFIG_ARM64_CRYPTO=y
CONFIG_CRYPTO_SHA1_ARM64_CE=y
CONFIG_CRYPTO_SHA2_ARM64_CE=y
CONFIG_CRYPTO_GHASH_ARM64_CE=y
CONFIG_CRYPTO_AES_ARM64_CE_CCM=y
CONFIG_CRYPTO_AES_ARM64_CE_BLK=y
CONFIG_CRYPTO_AES_ARM64_NEON_BLK=y
CONFIG_CRC_ITU_T=y
CONFIG_CRC7=y
```

## drivers/ambacv/Kconfig
```kconfig
menuconfig ARCH_AMBARELLA_CV
	tristate "Amba Cvtask Scheduler Support"
	default n
        depends on ARCH_AMBARELLA
	help
                This enables Ambarella cvtask scheduler module
```

## drivers/ambalink/Kconfig
```kconfig
menuconfig ARCH_AMBARELLA_AMBALINK
	bool "AmbaLink Support"
        depends on ARCH_AMBARELLA
        select AMBALINK_LOCK
        select RPMSG_VIRTIO
	help
                This enables AmbaLink support for Ambarella ARMv8 SoC Family.

if ARCH_AMBARELLA_AMBALINK

config AMBALINK_GUEST_2
        bool "AmbaLink Guest OS 2"
        default n
        help
          Select this option if current OS is the guest-2 OS in multi OS system.

source "drivers/ambalink/service/Kconfig"
source "drivers/ambalink/rpc/Kconfig"

endif
```

## drivers/ambalink/rpc/Kconfig
```kconfig
config AMBALINK_RPC
        bool "AmbaLink RPC support"
        depends on RPMSG
        depends on AMBARELLA_RPROC
        default y
        help
          AmbaLink Remote Procedure Call

config AMBALINK_LNX1_RPC2
        bool "AmbaLink RPC2 support for Linux1"
        depends on RPMSG
        depends on AMBARELLA_RPROC
        default n
        help
          AmbaLink Remote Procedure Call

config AMBALINK_LNX2_RPC2
        bool "AmbaLink RPC2 support for Linux2"
        depends on RPMSG
        depends on AMBARELLA_RPROC
        default n
        help
          AmbaLink Remote Procedure Call

config AMBALINK_RFS
        bool "AmbaLink RFS Support"
        depends on RPMSG
        default y
        help
          Enable RTOS to read/write ramfs through RPMSG

config AMBALINK_VFFS
        bool "AmbaLink FUSE VFFS"
        depends on RPMSG
        default n
        help
          A user space file system for RTOS accessing Linux, called FUSE VFFS.
```

## drivers/ambalink/service/Kconfig
```kconfig
config AMBALINK_LINKCTRL
        tristate "AmbaLink System Control"
        depends on RPMSG
        default y
        help
          A rpmsg server to handle the message between client and server for
          control purpose, such as suspend, resume.

config AMBALINK_SD
        tristate "AmbaLink SD Card Control"
        depends on RPMSG
        default n
        help
          AmbaLink SD controller RPMSG host driver.

config AMBALINK_PPM
        tristate "AmbaLink PPM device"
	default n
	help
	  create /dev/ppm to mmap physical memory
```

## drivers/firmware/ambarella/Kconfig
```kconfig
#
# Amlogic Secure Monitor driver
#
config AMBARELLA_SCM
	bool "Ambarella secure monitor driver"
	depends on ARCH_AMBARELLA && ARM64

config AMBARELLA_SMCCC_ACCESS_REG
	bool "Ambarella access secure registers"
	depends on AMBARELLA_SCM
```

## drivers/gsensor/Kconfig
```kconfig
#
#   G-Sensor drivers configuration
#

menu "G-Sensor support"

config SENSORS_MMA7455L
	tristate "Freescale 2g/4g/8g 3-Axis low-g accelerometer"
	depends on EXPERIMENTAL
	help
	  If you say yes here you get support for the Freescale 2g/4g/8g
	  3-Axis low-g accelerometer.
	  This driver can also be built as a module.  If so, the module
	  will be called mma7455l.

endmenu
```

## drivers/gyro/Kconfig
```kconfig
#
#   Gyro-Sensor drivers configuration
#

menu "Gyro-Sensor support"

config SENSORS_IDG2000
	tristate "IDG 2000 single-chip 2-axis digital MEMS Gyro Sensor"
	help
	  If you say yes here you get support for the IDG 2000 single-chip 2-axis digital MEMS Gyro Sensor.
	  This driver can also be built as a module.  If so, the module
	  will be called idg2000.

endmenu
```

## drivers/media/loopback/Kconfig
```kconfig
# SPDX-License-Identifier: GPL-2.0-only
config VIDEO_V4L2_LOOPBACK
	tristate "v4l2 loopback driver"
	depends on VIDEO_V4L2 && VIDEO_DEV
	help
	  Say Y if you want to use v4l2 loopback driver.
	  Looback driver allows it's user to present any userspace
	  video as a v4l2 device that can be handy for tesring purpose,
	  or for fixing bugs like upside down image, or for adding
	  nice effects to videochats
	  This driver can be compiled as a module, called v4l2loopback.
```

## drivers/mxc/Kconfig
```kconfig
# drivers/mxc/Kconfig

if ARCH_MXC

menu "MXC support drivers"

source "drivers/mxc/gpu-viv/Kconfig"

endmenu

endif

#if ARCH_MXC || ARCH_MXC_ARM64

menu "MXC support drivers"

# drivers common to MXC and MX8 go here:

#if ARCH_MXC_ARM64
source "drivers/mxc/hantro/Kconfig"
source "drivers/mxc/vpu_malone/Kconfig"
source "drivers/mxc/vpu_windsor/Kconfig"
#endif


endmenu

#endif
```

## drivers/net/ethernet/ambarella/Kconfig
```kconfig
#
# AMBARELLA network device configuration
#

config NET_VENDOR_AMBARELLA
	tristate "Ambarella 10/100/1000 GMAC Ethernet support"
	depends on PLAT_AMBARELLA
	select CRC32
	select PHYLIB
	select MII
	help
	  This driver supports Ambarella 10/100/1000 GMAC Ethernet.

config AMBARELLA_ETH_SUPPORT_IPC
	bool "Ambarella Media Soc Ethernet with IPC support"
	depends on NET_VENDOR_AMBARELLA
	default n
	help
  	  Support Checksum Offload Engine.
	  If unsure, say N.
```

## drivers/rpmsg/ambarella/Kconfig
```kconfig
menu "Ambarella RPMSG Host Programs"
depends on AMBARELLA_RPROC

source "drivers/rpmsg/ambarella/host/echo/Kconfig"
source "drivers/rpmsg/ambarella/host/rsh/Kconfig"
source "drivers/rpmsg/ambarella/host/veth/Kconfig"
source "drivers/rpmsg/ambarella/host/relay/Kconfig"

endmenu

menu "Ambarella RPMSG Client Programs"
depends on RPCLNT_SUPPORT

source "drivers/rpmsg/ambarella/clnt/echo/Kconfig"
source "drivers/rpmsg/ambarella/clnt/rsh/Kconfig"
source "drivers/rpmsg/ambarella/clnt/veth/Kconfig"
source "drivers/rpmsg/ambarella/clnt/relayexample/Kconfig"

endmenu

source "drivers/rpmsg/ambarella/common/rsh/Kconfig"
source "drivers/rpmsg/ambarella/common/veth/Kconfig"
```

## drivers/rpmsg/ambarella/clnt/relayexample/Kconfig
```kconfig
config RPDEV_RELAY_EXAMPLE
	tristate "RelayExample"
	help
	  A rpmsg example program for "communication between muntiOS framework".
```

## drivers/rpmsg/ambarella/host/relay/Kconfig
```kconfig
config RPMSG_HOSTRELAY
	tristate "relay"
	depends on RPMSG
	help
	  A rpmsg relay program, extend communication between Linux2 <=> RTOS
```

## drivers/servicebus/Kconfig
```kconfig
# SPDX-License-Identifier: GPL-2.0-only

config SERVICEBUS
	tristate "ServiceBus driver"
	default y
	help
	  The ServiceBus driver.
```

## drivers/soc/ambarella/Kconfig
```kconfig
#
# Ambarella SoC drivers
#

config AMBARELLA_ENABLE_GDMA
	bool "Ambarella Enable GDMA"
        depends on ARCH_AMBARELLA
	default n
	help
	  Say y here to enable gdma
```

## drivers/video/ambarella/Kconfig
```kconfig
config FB_AMBARELLA
	tristate "Ambarella frame buffer support"
	depends on FB && ARCH_AMBARELLA
	select FB_SYS_FILLRECT
	select FB_SYS_COPYAREA
	select FB_SYS_IMAGEBLIT
	select FB_SYS_FOPS
	help
          Frame buffer driver for Ambarella chips.
```

## fs/ambavfs/Kconfig
```kconfig
config AMBALINK_VFS
	tristate "Ambarella AmbaLink Virutal File System"
	depends on RPMSG
	default y
	help
	  Enable Linux to read/write RTOS native FS
```
