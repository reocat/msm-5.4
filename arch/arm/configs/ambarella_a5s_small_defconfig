## arch/arm/mach-ambarella/Kconfig
```kconfig
#
# arch/arm/mach-ambarella/Kconfig
#
# History:
#	2006/12/18 - [Charles Chiou] created file
#
# Copyright (C) 2004-2009, Ambarella, Inc.
#
# This program is free software; you can redistribute it and/or modify
# it under the terms of the GNU General Public License as published by
# the Free Software Foundation; either version 2 of the License, or
# (at your option) any later version.
#
# This program is distributed in the hope that it will be useful,
# but WITHOUT ANY WARRANTY; without even the implied warranty of
# MERCHANTABILITY or FITNESS FOR A PARTICULAR PURPOSE.  See the
# GNU General Public License for more details.
#
# You should have received a copy of the GNU General Public License
# along with this program; if not, write to the Free Software
# Foundation, Inc., 59 Temple Place, Suite 330, Boston, MA 02111-1307 USA
#

if PLAT_AMBARELLA

comment "Ambarella Board"

config MACH_AMBARELLA
	bool "Generic"
	default y
	help
	  Say Y here if you can't find suitable Board Name.

config MACH_COCONUT
	bool "Coconut"
	depends on PLAT_AMBARELLA_A5S
	default n
	help
	  Say Y here if you are using A5S Coconut.

config MACH_DURIAN
	bool "Durian"
	depends on PLAT_AMBARELLA_A7L
	default n
	help
	  Say Y here if you are using A7L Durian.

config MACH_GINKGO
	bool "Ginkgo"
	depends on PLAT_AMBARELLA_S2
	default n
	help
	  Say Y here if you are using S2 ginkgo.

config MACH_IXORA
	bool "Ixora"
	depends on PLAT_AMBARELLA_S2L
	default n
	help
	  Say Y here if you are using S2L Ixora.

endif
```

## arch/arm/plat-ambarella/Kconfig
```kconfig
#
# arch/arm/plat-ambarella/Kconfig
#
# History:
#	2010/05/25 - [Anthony Ginger] created file
#
# Copyright (C) 2004-2010, Ambarella, Inc.
#
# This program is free software; you can redistribute it and/or modify
# it under the terms of the GNU General Public License as published by
# the Free Software Foundation; either version 2 of the License, or
# (at your option) any later version.
#
# This program is distributed in the hope that it will be useful,
# but WITHOUT ANY WARRANTY; without even the implied warranty of
# MERCHANTABILITY or FITNESS FOR A PARTICULAR PURPOSE.  See the
# GNU General Public License for more details.
#
# You should have received a copy of the GNU General Public License
# along with this program; if not, write to the Free Software
# Foundation, Inc., 59 Temple Place, Suite 330, Boston, MA 02111-1307 USA
#

config PLAT_AMBARELLA
	bool
	depends on ARCH_AMBARELLA
	default y
	help
	  Base platform code for any Ambarella device

if PLAT_AMBARELLA
comment "Ambarella Platform"

config PLAT_AMBARELLA_GENERIC
	bool
	default n
	select GENERIC_GPIO
	select ARCH_REQUIRE_GPIOLIB
	select GENERIC_CLOCKEVENTS

config PLAT_AMBARELLA_CORTEX
	bool
	default n
	select ARM_GIC

config PLAT_AMBARELLA_SUPPORT_HW_CRYPTO
	bool
	default n

config PLAT_AMBARELLA_SUPPORT_HAL
	bool
	default n

config PLAT_AMBARELLA_SUPPORT_NEW_MEMORY_MAP
	bool
	default n

config PLAT_AMBARELLA_SUPPORT_USB
	bool
	default n

config PLAT_AMBARELLA_SUPPORT_SATA
	bool
	default n

config PLAT_AMBARELLA_DISABLE_8_16_ACCESS
	bool
	default n

choice
	prompt "Chip REV"

config PLAT_AMBARELLA_A2
	bool "A2"
	select CPU_ARM926T
	select PLAT_AMBARELLA_GENERIC
	help
	  Say Y here if you are using Ambarella A2.

config PLAT_AMBARELLA_A2S
	bool "A2S"
	select CPU_ARM926T
	select PLAT_AMBARELLA_GENERIC
	help
	  Say Y here if you are using Ambarella A2S.

config PLAT_AMBARELLA_A5S
	bool "A5S"
	select CPU_V6
	select CPU_32v6K
	select PLAT_AMBARELLA_GENERIC
	select PLAT_AMBARELLA_SUPPORT_HW_CRYPTO
	select PLAT_AMBARELLA_SUPPORT_HAL
	help
	  Say Y here if you are using Ambarella A5S.

config PLAT_AMBARELLA_A7
	bool "A7"
	select CPU_V6
	select CPU_32v6K
	select PLAT_AMBARELLA_GENERIC
	select PLAT_AMBARELLA_SUPPORT_HW_CRYPTO
	select PLAT_AMBARELLA_SUPPORT_HAL
	help
	  Say Y here if you are using Ambarella A7.

config PLAT_AMBARELLA_I1_ARM11
	bool "iOne ARM11"
	select CPU_V6
	select CPU_32v6K
	select PLAT_AMBARELLA_GENERIC
	select PLAT_AMBARELLA_SUPPORT_HW_CRYPTO
	select PLAT_AMBARELLA_SUPPORT_HAL
	select PLAT_AMBARELLA_SUPPORT_NEW_MEMORY_MAP
	select PLAT_AMBARELLA_SUPPORT_USB
	select PLAT_AMBARELLA_SUPPORT_SATA
	help
	  Say Y here if you are using Ambarella I1 ARM11.

config PLAT_AMBARELLA_I1_CORTEX
	bool "iOne Cortex"
	select CPU_V7
	select PLAT_AMBARELLA_GENERIC
	select PLAT_AMBARELLA_CORTEX
	select PLAT_AMBARELLA_SUPPORT_HW_CRYPTO
	select PLAT_AMBARELLA_SUPPORT_HAL
	select PLAT_AMBARELLA_SUPPORT_NEW_MEMORY_MAP
	select PLAT_AMBARELLA_SUPPORT_USB
	select PLAT_AMBARELLA_SUPPORT_SATA
	select PLAT_AMBARELLA_DISABLE_8_16_ACCESS
	help
	  Say Y here if you are using Ambarella I1 Cortex.

endchoice

menu "Generic Platform Configuration"
depends on PLAT_AMBARELLA_GENERIC

config AMBARELLA_QUICK_INIT
	bool "Suport quick init"
	default y
	help
	  If you are not sure, say Y here.

config AMBARELLA_RAW_BOOT
	bool "Raw boot mode"
	default n
	depends on !AMBARELLA_QUICK_INIT
	help
	  If you are not sure, say N here.

config AMBARELLA_SUPPORT_SPARSEMEM
	bool "Suport SPARSEMEM"
	default n
	select ARCH_SPARSEMEM_ENABLE
	select SPARSEMEM_STATIC
	select ARCH_ENABLE_MEMORY_HOTPLUG
	select ARCH_MEMORY_PROBE
	help
	  If you are not sure, say N here.

config AMBARELLA_SUPPORT_CLOCKSOURCE
	bool "Suport clocksource"
	default y
	help
	  If you are not sure, say Y here.

menu "Proc file system support"

config AMBARELLA_GPIO_PROC
	bool "Ambarella GPIO proc support"
	default n
	depends on PROC_FS
	---help---
	  Add /proc/ambarella/gpio for Ambarella GPIO access.

	  If you are not sure, say N here.

config AMBARELLA_ADC_PROC
	bool "Ambarella ADC proc support"
	default n
	depends on PROC_FS
	---help---
	  Add /proc/ambarella/adc for Ambarella ADC access.

	  If you are not sure, say N here.

config AMBARELLA_PWM_PROC
	bool "Ambarella PWM proc support"
	default n
	depends on PROC_FS
	---help---
	  Add /proc/ambarella/pwm for Ambarella PWM access.

	  If you are not sure, say N here.

config AMBARELLA_DMA_PROC
	bool "Ambarella DMA proc support"
	default n
	depends on PROC_FS
	---help---
	  Add /proc/ambarella/dma for Ambarella DMA debug.

	  If you are not sure, say N here.

config AMBARELLA_PLL_PROC
	bool "Ambarella PLL proc support"
	default n
	depends on PROC_FS
	---help---
	  Add /proc/ambarella/pll for Ambarella PLL access.

	  If you are not sure, say N here.

endmenu

menu "PPM Configuration"

config AMBARELLA_PPM_SIZE
	hex "PPM SIZE"
	default 0x00000000
	help
	  Specify the size from the start of physical DRAM address to reserve.

config AMBARELLA_ZRELADDR
	hex "ZRELADDR"
	default 0x00108000
	help
	  Specify the kernel entry point start physical address.

config AMBARELLA_TEXTOFS
	hex "TEXTOFS"
	default 0x00108000
	help
	  Speicify the relative text offset.

config AMBARELLA_PARAMS_PHYS
	hex "PARAMS PHYS"
	default 0x000c0000
	help
	  Specify the physical address for kernel parameters.

config AMBARELLA_INITRD_PHYS
	hex "INITRD PHYS"
	default 0x00a00000
	help
	  Specify the physical address for initrd.

endmenu

config AMBARELLA_TIMER_HZ
       int "Kernel HZ (jiffies per second)"
       range 100 1000
       default "100"
       help
	  Please test and figure out what you need.

endmenu

endif
```

## arch/arm64/configs/ambarella_h2_ambalink_cv1_defconfig
```kconfig
BR2_aarch64=y
BR2_DL_DIR="$(TOPDIR)/../dl"
BR2_PRIMARY_SITE="http://buildroot.ambarella.com/2013.02"
BR2_JLEVEL=4
BR2_CCACHE=y
BR2_PACKAGE_OVERRIDE_FILE="ambarella/local.mk"
BR2_TOOLCHAIN_EXTERNAL=y
BR2_TOOLCHAIN_EXTERNAL_GDB_SERVER_COPY=y
BR2_ENABLE_LOCALE_PURGE=y
BR2_ENABLE_LOCALE_WHITELIST="C en_US"
BR2_TARGET_OPTIMIZATION="-mcpu=cortex-a53+crypto"
BR2_TARGET_GENERIC_HOSTNAME="H2"
BR2_TARGET_GENERIC_ISSUE="Welcome to H2 AmbaLink Linux"
BR2_ROOTFS_DEVICE_CREATION_DYNAMIC_MDEV=y
BR2_ROOTFS_DEVICE_TABLE="ambarella/package/ambarella_customize/source/device_table.txt"
BR2_ROOTFS_SKELETON_CUSTOM=y
BR2_ROOTFS_SKELETON_CUSTOM_PATH="ambarella/package/ambarella_customize/source/skeleton"
BR2_ROOTFS_POST_BUILD_SCRIPT="ambarella/package/ambarella_customize/scripts/post_build.sh"
BR2_LINUX_KERNEL=y
BR2_LINUX_KERNEL_CUSTOM_VERSION=y
BR2_LINUX_KERNEL_USE_CUSTOM_CONFIG=y
BR2_LINUX_KERNEL_CUSTOM_CONFIG_FILE="$(LINUX_OVERRIDE_SRCDIR)/arch/arm64/configs/ambarella_h2_ambalink_cv1_defconfig"
BR2_LINUX_KERNEL_IMAGE_TARGET_CUSTOM=y
BR2_LINUX_KERNEL_IMAGE_TARGET_NAME="Image"
BR2_LINUX_KERNEL_DTS_SUPPORT=y
BR2_LINUX_KERNEL_USE_CUSTOM_DTS=y
BR2_LINUX_KERNEL_CUSTOM_DTS_PATH="$(TOPDIR)/../ambarella/bootloader/boards/h2bub/bsp/h2bub.dts"
BR2_PACKAGE_BUSYBOX_CONFIG="ambarella/package/ambarella_customize/config/busybox-1.20.x.full.config"
BR2_PACKAGE_BUSYBOX_SHOW_OTHERS=y
BR2_PACKAGE_IOZONE=y
BR2_PACKAGE_STRACE=y
BR2_PACKAGE_OPENSSL=y
BR2_PACKAGE_OPENSSL_BIN=y
BR2_PACKAGE_NCURSES=y
BR2_PACKAGE_DNSMASQ=y
# BR2_PACKAGE_DNSMASQ_TFTP is not set
BR2_PACKAGE_IPERF=y
BR2_PACKAGE_WIRELESS_TOOLS=y
BR2_PACKAGE_WIRELESS_TOOLS_LIB=y
BR2_PACKAGE_WPA_SUPPLICANT=y
BR2_PACKAGE_WPA_SUPPLICANT_AP_SUPPORT=y
BR2_PACKAGE_WPA_SUPPLICANT_EAP=y
BR2_PACKAGE_WPA_SUPPLICANT_HOTSPOT=y
BR2_PACKAGE_WPA_SUPPLICANT_DEBUG_SYSLOG=y
BR2_PACKAGE_WPA_SUPPLICANT_WPS=y
BR2_PACKAGE_WPA_SUPPLICANT_CLI=y
BR2_TARGET_ROOTFS_SQUASHFS=y
BR2_TARGET_ROOTFS_SQUASHFS4_LZO=y
BR2_TARGET_ROOTFS_TAR_GZIP=y
BR2_TARGET_ROOTFS_UBIFS=y
BR2_TARGET_ROOTFS_UBIFS_LEBSIZE=0x1f000
BR2_TARGET_ROOTFS_UBIFS_MAXLEBCNT=2047
BR2_TARGET_ROOTFS_UBIFS_RT_NONE=y
BR2_TARGET_ROOTFS_UBI=y
BR2_TARGET_ROOTFS_UBI_SUBSIZE=2048
BR2_TARGET_ROOTFS_UBI_USE_CUSTOM_CONFIG=y
BR2_TARGET_ROOTFS_UBI_CUSTOM_CONFIG_FILE="ambarella/fs/ubifs/ubinize-ambarella.cfg"
BR2_PACKAGE_AMBADAG=y
BR2_PACKAGE_NETWORK_TURNKEY=y
BR2_PACKAGE_AMBA_UTIL=y
BR2_PACKAGE_AMBA_EXAMPLES=y
# BR2_PACKAGE_AMBA_EVENTNOTIFIER_EXAMPLE is not set
# BR2_PACKAGE_AMBA_EXAMPLE_FRAMER is not set
# BR2_PACKAGE_AMBA_EXAMPLE_SHAREPREVIEW is not set
# BR2_PACKAGE_AMBA_EXAMPLE_STREAMIN is not set
BR2_PACKAGE_BCMDHD=y
BR2_PACKAGE_BCMDHD_43340=y
BR2_PACKAGE_BCMDHD_AMPAK=y
# BR2_AMBARELLA_AUTOHIBER is not set
```
