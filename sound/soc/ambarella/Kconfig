## sound/soc/ambarella/Kconfig
```kconfig
config SND_AMBARELLA_SOC
	tristate "SoC Audio for the Ambarella chips"
	depends on ARCH_AMBARELLA && SND_SOC
	help
	  Say Y or M if you want to add support for codecs attached to
	  the AMBARELLA I2S interface. You will also need
	  to select the audio interfaces to support below.

config SND_AMBARELLA_SOC_I2S
	tristate

menuconfig SND_AMBARELLA_BOARD
	tristate "Ambarella Board Type"
	depends on SND_AMBARELLA_SOC
	help
	  Say Y or M to select specific ambarella board.

if SND_AMBARELLA_BOARD
	
config IPCAM_BOARD
	tristate "IPCAM Board [With Internel Codec]"
	depends on SND_AMBARELLA_SOC && ARCH_AMBARELLA_A2
	select SND_AMBARELLA_SOC_I2S
	select SND_SOC_AMBARELLA_A2AUC
	help
	  Say Y if you want to add internal audio codec support for
	  SoC audio on Ambarella IPCAM Board.

config A2SBUB_BOARD
	tristate "A2SBUB Board [With ADAV803 Codec]"
	depends on SND_AMBARELLA_SOC && (ARCH_AMBARELLA_A2S || ARCH_AMBARELLA_A2M)
	select SND_AMBARELLA_SOC_I2S
	select SND_SOC_ADAV803
	help
	  Say Y if you want to add adav803 audio codec support for
	  SoC audio on Ambarella A2SBUB Board.

config A2SIPCAM_BOARD
	tristate "A2SIPCAM Board [With CS42L51 Codec]"
	depends on SND_AMBARELLA_SOC && ARCH_AMBARELLA_A2S
	select SND_AMBARELLA_SOC_I2S
	select SND_SOC_CS42L51
	help
	  Say Y if you want to add cs42l51 audio codec support for
	  SoC audio on Ambarella A2SIPCAM Board.

config A5SSDK_BOARD
	tristate "A5SSDK Board [With AK4642 Codec]"
	depends on SND_AMBARELLA_SOC && ARCH_AMBARELLA_A5S
	select SND_AMBARELLA_SOC_I2S
	select SND_SOC_AK4642
	help
	  Say Y if you want to add ak4642 audio codec support for
	  SoC audio on Ambarella A5SSDK Board.

config AMBARELLA_DUMMY_BOARD
	tristate "Ambarella Dummy Board [With Dummy Codec]"
	select SND_AMBARELLA_SOC_I2S
	select SND_SOC_AMBARELLA_DUMMY
	help
	  Say Y if you want to add dummy audio codec support for
	  SoC audio on Ambarella Board. Generally, it's for HDMI.

endif
```

## techpack/Kconfig
```kconfig
# SPDX-License-Identifier: GPL-2.0
menu "Techpack Drivers"

source "techpack/wlan/qcacld-3.0/Kconfig"

endmenu
```
